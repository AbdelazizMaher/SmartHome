## yoctoImage/conf/bblayers.conf
```bitbake
# POKY_BBLAYERS_CONF_VERSION is increased each time build/conf/bblayers.conf
# changes incompatibly
POKY_BBLAYERS_CONF_VERSION = "2"

BBPATH = "${TOPDIR}"
BBFILES ?= ""

BBLAYERS ?= " \
  /home/abdelaziz/yocto/poky/meta \
  /home/abdelaziz/yocto/poky/meta-poky \
  /home/abdelaziz/yocto/poky/meta-yocto-bsp \
  /home/abdelaziz/yocto/meta-raspberrypi \
  /home/abdelaziz/yocto/meta-openembedded/meta-oe \
  /home/abdelaziz/yocto/meta-openembedded/meta-python \
  /home/abdelaziz/yocto/meta-openembedded/meta-networking \
  /home/abdelaziz/yocto/meta-openembedded/meta-multimedia \
  /home/abdelaziz/yocto/meta-smarthome \
  "
```

## yoctoImage/meta-smarthome/conf/layer.conf
```bitbake
# We have a conf and classes directory, add to BBPATH
BBPATH .= ":${LAYERDIR}"

# We have recipes-* directories, add to BBFILES
BBFILES += "${LAYERDIR}/recipes-*/*/*.bb \
            ${LAYERDIR}/recipes-*/*/*.bbappend"

BBFILE_COLLECTIONS += "meta-smarthome"
BBFILE_PATTERN_meta-smarthome = "^${LAYERDIR}/"
BBFILE_PRIORITY_meta-smarthome = "6"

LAYERDEPENDS_meta-smarthome = "core"
LAYERSERIES_COMPAT_meta-smarthome = "kirkstone"
```
